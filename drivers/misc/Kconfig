## drivers/misc/Kconfig
```kconfig
# SPDX-License-Identifier: GPL-2.0-only
#
# Misc strange devices
#

menu "Misc devices"

config KHADAS_MCU
	tristate "Khadas MCU"
	default m
	help
		This driver is for Khadas MCU.
		Control fan && WoL, and the power for CPU

endmenu
```

## drivers/npu/Kconfig
```kconfig
menu "Amlogic NPU Support"
 
	config AMLOGIC_NPU
		tristate "amlogic NPU module"
		default n
		help
			Driver for NPU.

endmenu     
```
